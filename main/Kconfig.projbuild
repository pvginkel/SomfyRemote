## main/Kconfig.projbuild
```kconfig
menu "Device Configuration"

    orsource "$IDF_PATH/examples/common_components/env_caps/$IDF_TARGET/Kconfig.env_caps"

    config DEVICE_CONFIG_ENDPOINT
        string "Device config endpoint (%s becomes MAC address)"

    config DEVICE_GDO0_PIN
        int "GDO0 pin"
        default -1

    config DEVICE_GDO1_PIN
        int "GDO1 (MISO) pin"
        default -1

    config DEVICE_GDO2_PIN
        int "GDO2 pin"
        default -1

    config DEVICE_SCK_PIN
        int "SCK pin"
        default -1

    config DEVICE_CSN_PIN
        int "CSN pin"
        default -1

    config DEVICE_MOSI_PIN
        int "MOSI pin"
        default -1

endmenu
```
