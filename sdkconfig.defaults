## sdkconfig.defaults
```kconfig
# Application configuration

CONFIG_DEVICE_GDO0_PIN=4
CONFIG_DEVICE_GDO1_PIN=6
CONFIG_DEVICE_GDO2_PIN=12
CONFIG_DEVICE_SCK_PIN=5
CONFIG_DEVICE_CSN_PIN=14
CONFIG_DEVICE_MOSI_PIN=13

# Arduino configuration

CONFIG_FREERTOS_HZ=1000

# Setup flash

CONFIG_ESPTOOLPY_FLASHSIZE_4MB=y
CONFIG_PARTITION_TABLE_CUSTOM=y

# SPIRAM

CONFIG_SPIRAM=y
CONFIG_SPIRAM_FETCH_INSTRUCTIONS=y
CONFIG_SPIRAM_RODATA=y
CONFIG_SPIRAM_SPEED_80M=y

# MQTT

CONFIG_MQTT_TOPIC_PREFIX="somfy_remote"
CONFIG_MQTT_DEVICE_MANUFACTURER="Pieter"
CONFIG_MQTT_DEVICE_MODEL="Somfy Remote"
CONFIG_MQTT_DEVICE_MODEL_ID="Somfy Remote v1"
```
